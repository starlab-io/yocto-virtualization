## meta-virtualization-intel/conf/distro/poky-xen.conf
```bitbake
require conf/distro/poky.conf
require conf/distro/include/security_flags.inc

# With all the CFLAGS manipulation that Xen has to do for bare metal
# binaries and user space tools we can't just blanket inject these into
# its build process
SECURITY_CFLAGS_pn-xen = ""

DISTRO = "poky-xen"
DISTRO_NAME = "Poky Xen"
DISTRO_VERSION = "0.1"
MAINTAINER = "Star Lab <support@starlab.io>"

# Remove some features we don't want
DISTRO_FEATURES_remove += "\
	opengl wayland x11 3g nfc pulseaudio alsa bluetooth irda pcmcia \
	wifi usbgadget pam \
	"

# Add some feature we want
DISTRO_FEATURES_append += "xen libc-charsets libc-locales libc-locale-code"

# Yocoto fails to take into account the Xen console and does the
# wrong thing when setting up the console. The meta-virt layer
# adds the Xen console when DISTRO_FEATURES has 'xen' but does
# not remove the wrong console
SERIAL_CONSOLES = " "

# Disable the language support
USE_NLS="no"

# Remove ldconfig from the glib runtime packages
# See https://www.yoctoproject.org/docs/2.3/ref-manual/ref-manual.html#migration-2.3-miscellaneous-changes
DISTRO_FEATURES_BACKFILL_CONSIDERED_append = " ldconfig"

# Use mdev rather than udev as the device manager
VIRTUAL-RUNTIME_dev_manager = ""

# Remove the default keyboard maps
VIRTUAL-RUNTIME_keymaps = ""

# There are currently two different providers (iasl and acpica)
# Set the preferred proviver to iasl-native
PREFERRED_PROVIDER_iasl-native = "iasl-native"

# Set the LIBC features based on the full list existing in pyro
# See https://knowledge.windriver.com/en-us/000_Products/000/010/000/060/000_Wind_River_Linux_Platform_Developer's_Guide%2C_7.0/060/0A0/010
DISTRO_FEATURES_LIBC = ""
#DISTRO_FEATURES_LIBC += "ipv6"
#DISTRO_FEATURES_LIBC += "libc-backtrace"
#DISTRO_FEATURES_LIBC += "libc-big-macros"
#DISTRO_FEATURES_LIBC += "libc-bsd"
#DISTRO_FEATURES_LIBC += "libc-cxx-tests"
#DISTRO_FEATURES_LIBC += "libc-catgets"
#DISTRO_FEATURES_LIBC += "libc-charsets"
#DISTRO_FEATURES_LIBC += "libc-crypt"
#DISTRO_FEATURES_LIBC += "libc-crypt-ufc"
#DISTRO_FEATURES_LIBC += "libc-db-aliases"
#DISTRO_FEATURES_LIBC += "libc-envz"
#DISTRO_FEATURES_LIBC += "libc-fcvt"
#DISTRO_FEATURES_LIBC += "libc-fmtmsg"
#DISTRO_FEATURES_LIBC += "libc-fstab"
#DISTRO_FEATURES_LIBC += "libc-ftraverse"
#DISTRO_FEATURES_LIBC += "libc-getlogin"
#DISTRO_FEATURES_LIBC += "libc-idn"
DISTRO_FEATURES_LIBC += "ipv4"
#DISTRO_FEATURES_LIBC += "libc-inet-anl"
DISTRO_FEATURES_LIBC += "libc-libm"
DISTRO_FEATURES_LIBC += "libc-libm-big"
#DISTRO_FEATURES_LIBC += "libc-locales"
#DISTRO_FEATURES_LIBC += "libc-locale-code"
#DISTRO_FEATURES_LIBC += "libc-memusage"
#DISTRO_FEATURES_LIBC += "libc-nis"
#DISTRO_FEATURES_LIBC += "libc-nsswitch"
#DISTRO_FEATURES_LIBC += "libc-rcmd"
#DISTRO_FEATURES_LIBC += "libc-rtld-debug"
#DISTRO_FEATURES_LIBC += "libc-spawn"
#DISTRO_FEATURES_LIBC += "libc-streams"
#DISTRO_FEATURES_LIBC += "libc-sunrpc"
#DISTRO_FEATURES_LIBC += "libc-utmp"
#DISTRO_FEATURES_LIBC += "libc-utmpx"
#DISTRO_FEATURES_LIBC += "libc-wordexp"
DISTRO_FEATURES_LIBC += "libc-posix-clang-wchar"
DISTRO_FEATURES_LIBC += "libc-posix-regexp"
DISTRO_FEATURES_LIBC += "libc-posix-regexp-glibc"
DISTRO_FEATURES_LIBC += "libc-posix-wchar-io"

EFI_PROVIDER = "grub-efi"
```

## meta-virtualization-intel/conf/layer.conf
```bitbake
# We have a conf and classes directory, append to BBPATH
BBPATH .= ":${LAYERDIR}"

# We have a recipes directory, add to BBFILES
BBFILES += "${LAYERDIR}/recipes*/*/*.bb ${LAYERDIR}/recipes*/*/*.bbappend"

BBFILE_COLLECTIONS += "virtualization-intel"
BBFILE_PATTERN_virtualization-intel := "^${LAYERDIR}/"
BBFILE_PRIORITY_virtualization-intel = "99"

LAYERVERSION_virtualization-intel = "1"
LAYERDEPENDS_virtualization-intel = "core openembedded-layer meta-python virtualization-layer"

# We don't currently need to support i18n
GLIBC_GENERATE_LOCALES = "en_US.UTF-8"
IMAGE_LINGUAS ?= "en-us"
USE_NLS = "no"
```
